#include "ili9488.h"

/* ===== FONT (MOVE FULL ARRAY HERE) ===== */
// clang-format off
const unsigned char font[] = {
	0x00, 0x00, 0x00, 0x00, 0x00,
	0x3E, 0x5B, 0x4F, 0x5B, 0x3E,
	0x3E, 0x6B, 0x4F, 0x6B, 0x3E,
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	0x00, 0x00, 0x00, 0x00, 0x00
};
// clang-format on

/* ===== INTERNAL STATE ===== */
static uint16_t _width = ILI9488_TFTWIDTH;
static uint16_t _height = ILI9488_TFTHEIGHT;

/* ===== SPI HELPERS ===== */

static void writeCommand(uint8_t cmd) {
	DC_COMMAND();
	CS_ACTIVE();
	HAL_SPI_Transmit(&hspi1, &cmd, 1, HAL_MAX_DELAY);
	CS_IDLE();
}

static void writeDataBuffer(uint8_t *buff, uint32_t size) {
	DC_DATA();
	CS_ACTIVE();
	HAL_SPI_Transmit(&hspi1, buff, size, HAL_MAX_DELAY);
	CS_IDLE();
}

static inline void color565_to_666(uint16_t color, uint8_t *rgb) {
	rgb[0] = ((color >> 11) & 0x1F) << 3; // R
	rgb[1] = ((color >> 5) & 0x3F) << 2;  // G
	rgb[2] = (color & 0x1F) << 3;		  // B
}

/* ===== ADDRESS WINDOW ===== */

static void setAddrWindow(uint16_t x1, uint16_t y1, uint16_t x2, uint16_t y2) {
	uint8_t data[4];

	writeCommand(0x2A);
	data[0] = x1 >> 8;
	data[1] = x1 & 0xFF;
	data[2] = x2 >> 8;
	data[3] = x2 & 0xFF;
	writeDataBuffer(data, 4);

	writeCommand(0x2B);
	data[0] = y1 >> 8;
	data[1] = y1 & 0xFF;
	data[2] = y2 >> 8;
	data[3] = y2 & 0xFF;
	writeDataBuffer(data, 4);

	writeCommand(0x2C);
}

/* ===== INIT ===== */

void ILI9488_Init(void) {
	RST_LOW();
	HAL_Delay(20);
	RST_HIGH();
	HAL_Delay(150);

	writeCommand(0x3A); // Pixel format
	uint8_t fmt = 0x66; // 18-bit
	writeDataBuffer(&fmt, 1);

	writeCommand(0x36); // MADCTL
	uint8_t madctl = 0x48;
	writeDataBuffer(&madctl, 1);

	writeCommand(0x11); // Sleep out
	HAL_Delay(120);

	writeCommand(0x29); // Display on
}

/* ===== ROTATION ===== */

void ILI9488_SetRotation(uint8_t r) {
	writeCommand(0x36);

	uint8_t data;
	switch (r & 3) {
	case 0:
		data = 0x48;
		_width = 320;
		_height = 480;
		break;
	case 1:
		data = 0x28;
		_width = 480;
		_height = 320;
		break;
	case 2:
		data = 0x88;
		_width = 320;
		_height = 480;
		break;
	default:
		data = 0xE8;
		_width = 480;
		_height = 320;
		break;
	}

	writeDataBuffer(&data, 1);
}

/* ===== Helpers ===== */

void ILI9488_DrawPixel(uint16_t x, uint16_t y, uint16_t color) {
	if (x >= _width || y >= _height)
		return;

	uint8_t rgb[3];
	color565_to_666(color, rgb);

	setAddrWindow(x, y, x, y);
	writeDataBuffer(rgb, 3);
}
#define BURST_PIXELS 256
#define SPI_TIMEOUT 10

static void pushColorBurst(uint16_t color, uint32_t count) {
	uint8_t rgb[3] = {((color >> 11) & 0x1F) << 3, ((color >> 5) & 0x3F) << 2, (color & 0x1F) << 3};

	static uint8_t buffer[3 * BURST_PIXELS];

	for (int i = 0; i < BURST_PIXELS; i++) {
		buffer[i * 3 + 0] = rgb[0];
		buffer[i * 3 + 1] = rgb[1];
		buffer[i * 3 + 2] = rgb[2];
	}

	DC_DATA();
	CS_ACTIVE();

	while (count) {
		uint32_t chunk = (count > BURST_PIXELS) ? BURST_PIXELS : count;
		HAL_SPI_Transmit(&hspi1, buffer, chunk * 3, SPI_TIMEOUT);
		count -= chunk;
	}

	CS_IDLE();
}

/* ===== FAST FILL SCREEN ===== */

void ILI9488_FillScreen(uint16_t color) {
	setAddrWindow(0, 0, _width - 1, _height - 1);
	pushColorBurst(color, (uint32_t)_width * _height);
}

/* ===== FAST RECT ===== */

void ILI9488_FillRect(uint16_t x, uint16_t y, uint16_t w, uint16_t h, uint16_t color) {
	if (x >= _width || y >= _height)
		return;

	if ((x + w) > _width)
		w = _width - x;
	if ((y + h) > _height)
		h = _height - y;

	setAddrWindow(x, y, x + w - 1, y + h - 1);
	pushColorBurst(color, (uint32_t)w * h);
}

/* ===== TEXT ===== */

void ILI9488_DrawChar(uint16_t x, uint16_t y, char c, uint16_t color, uint16_t bg, uint8_t size) {
	if (x >= _width || y >= _height)
		return;

	for (uint8_t i = 0; i < 5; i++) {
		uint8_t line = font[c * 5 + i];

		for (uint8_t j = 0; j < 8; j++) {
			uint16_t drawColor = (line & 1) ? color : bg;

			if (size == 1)
				ILI9488_DrawPixel(x + i, y + j, drawColor);
			else
				ILI9488_FillRect(x + i * size, y + j * size, size, size, drawColor);

			line >>= 1;
		}
	}
}

void ILI9488_WriteString(uint16_t x, uint16_t y, const char *str, uint16_t color, uint16_t bg, uint8_t size) {
	while (*str) {
		if (x + 6 * size >= _width)
			break;

		ILI9488_DrawChar(x, y, *str, color, bg, size);
		x += 6 * size;
		str++;
	}
}

void ILI9488_DrawImage(uint16_t x, uint16_t y, uint16_t w, uint16_t h, const uint8_t *img) {
	if (x >= _width || y >= _height)
		return;

	if ((x + w) > _width)
		w = _width - x;
	if ((y + h) > _height)
		h = _height - y;

	setAddrWindow(x, y, x + w - 1, y + h - 1);

	DC_DATA();
	CS_ACTIVE();

	uint32_t totalBytes = (uint32_t)w * h * 3;
	uint32_t sent = 0;

	while (sent < totalBytes) {
		uint32_t chunk = (totalBytes - sent > 1024) ? 1024 : (totalBytes - sent);

		HAL_SPI_Transmit(&hspi1, (uint8_t *)(img + sent), chunk, SPI_TIMEOUT);

		sent += chunk;
	}

	CS_IDLE();
}
